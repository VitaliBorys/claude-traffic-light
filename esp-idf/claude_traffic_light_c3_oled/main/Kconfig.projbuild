## esp-idf/claude_traffic_light_c3_oled/main/Kconfig.projbuild
```kconfig
menu "Example Configuration"

    config EXAMPLE_WIFI_SSID
        string "WiFi SSID"
        default "myssid"
        help
            SSID (network name) to connect to.

    config EXAMPLE_WIFI_PASSWORD
        string "WiFi Password"
        default "mypassword"
        help
            WiFi password (WPA or WPA2) to use.

    config EXAMPLE_MQTT_BROKER_URI
        string "MQTT broker URI"
        default "mqtt://192.168.1.50:1883"
        help
            URI of the local MQTT broker that claude_usage_statusline.py
            publishes usage state to (see ~/.claude/claude_usage_statusline.py).

    config EXAMPLE_MQTT_TOPIC
        string "MQTT usage-state topic"
        default "claude/usage/state"
        help
            Retained topic the statusline publisher writes usage-state
            JSON to.

endmenu
```
